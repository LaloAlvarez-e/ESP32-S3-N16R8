## main/Kconfig.projbuild
```kconfig
menu "ESP32-S3-N16R8 Application"

    menu "WiFi Configuration"

        config APP_WIFI_SSID
            string "WiFi SSID"
            default "myssid"
            help
                SSID (network name) for the board to connect to.

        config APP_WIFI_PASSWORD
            string "WiFi Password"
            default "mypassword"
            help
                WiFi password (WPA/WPA2) for the board to connect to.

        config APP_WIFI_RETRY_MAX
            int "Maximum WiFi retry count"
            default 5
            help
                Number of reconnection attempts before giving up.

    endmenu

    menu "HTTP Server Configuration"

        config APP_HTTP_SERVER_PORT
            int "HTTP server port"
            default 80
            range 1 65535
            help
                TCP port the built-in HTTP server listens on.

    endmenu

endmenu
```

## sdkconfig.defaults
```kconfig
# sdkconfig.defaults — ESP32-S3-N16R8 (16 MB Flash / 8 MB OPI PSRAM)
# Apply with: idf.py -DSDKCONFIG_DEFAULTS=sdkconfig.defaults build

# ---------------------------------------------------------------------------
# Target
# ---------------------------------------------------------------------------
CONFIG_IDF_TARGET="esp32s3"

# ---------------------------------------------------------------------------
# Flash
# ---------------------------------------------------------------------------
CONFIG_ESPTOOLPY_FLASHSIZE_16MB=y
CONFIG_ESPTOOLPY_FLASHSIZE="16MB"
CONFIG_ESPTOOLPY_FLASHMODE_QIO=y
CONFIG_ESPTOOLPY_FLASHFREQ_80M=y
CONFIG_PARTITION_TABLE_CUSTOM=y
CONFIG_PARTITION_TABLE_CUSTOM_FILENAME="partitions.csv"

# ---------------------------------------------------------------------------
# PSRAM (Octal SPI, 8 MB)
# ---------------------------------------------------------------------------
CONFIG_ESP32S3_SPIRAM_SUPPORT=y
CONFIG_SPIRAM_MODE_OCT=y
CONFIG_SPIRAM_SPEED_80M=y
CONFIG_SPIRAM_USE_MALLOC=y
CONFIG_SPIRAM_MALLOC_ALWAYSINTERNAL=16384

# ---------------------------------------------------------------------------
# CPU
# ---------------------------------------------------------------------------
CONFIG_ESP32S3_DEFAULT_CPU_FREQ_240=y
CONFIG_ESP32S3_DEFAULT_CPU_FREQ_MHZ=240

# ---------------------------------------------------------------------------
# FreeRTOS
# ---------------------------------------------------------------------------
CONFIG_FREERTOS_HZ=1000
CONFIG_FREERTOS_UNICORE=n

# ---------------------------------------------------------------------------
# Logging
# ---------------------------------------------------------------------------
CONFIG_LOG_DEFAULT_LEVEL_INFO=y
CONFIG_LOG_MAXIMUM_LEVEL_DEBUG=y

# ---------------------------------------------------------------------------
# WiFi
# ---------------------------------------------------------------------------
CONFIG_ESP_WIFI_STATIC_RX_BUFFER_NUM=10
CONFIG_ESP_WIFI_DYNAMIC_RX_BUFFER_NUM=32
CONFIG_ESP_WIFI_TX_BUFFER_TYPE_DYNAMIC=y

# ---------------------------------------------------------------------------
# HTTP Server
# ---------------------------------------------------------------------------
CONFIG_HTTPD_MAX_REQ_HDR_LEN=1024
CONFIG_HTTPD_MAX_URI_LEN=512

# ---------------------------------------------------------------------------
# Camera / JPEG
# ---------------------------------------------------------------------------
CONFIG_CAMERA_TASK_STACK_SIZE=4096
```
